## west.yml
```yaml
manifest:
  remotes:
    - name: ncs
      url-base: https://github.com/nrfconnect
  projects:
    - name: sdk-nrf
      remote: ncs
      path: nrf
      revision: v3.1.1
      import: true
  self:
    path: modules/lib/test-company-sdk
```
